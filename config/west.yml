## config/west.yml
```yaml
manifest:
  remotes:
    - name: darknao
      url-base: https://github.com/darknao
    - name: inonprince
      url-base: https://github.com/inonprince
  projects:
    - name: zmk
      remote: darknao
      revision: rgb-layer-24.12
      import: app/west.yml
    - name: zmk-hid-trackball-interface
      remote: inonprince
      revision: main
  self:
    path: config
```

## dts/bindings/behaviors/zmk,behavior-kvm-state-color.yaml
```yaml
# SPDX-License-Identifier: MIT

description: Return red for RGB when KVM state is 2, otherwise no color

compatible: "zmk,behavior-kvm-state-color"

include: zero_param.yaml
```

## dts/bindings/behaviors/zmk,behavior-kvm-switch.yaml
```yaml
# SPDX-License-Identifier: MIT

description: Toggle KVM target between Ctrl Ctrl 1 and Ctrl Ctrl 2

compatible: "zmk,behavior-kvm-switch"

include: zero_param.yaml
```
